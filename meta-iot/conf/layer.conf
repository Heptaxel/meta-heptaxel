## meta-iot/conf/layer.conf
```bitbake
# We have a conf and classes directory, append to BBPATH
BBPATH .= ":${LAYERDIR}"

# We have a recipes directory, add to BBFILES
BBFILES += "${LAYERDIR}/recipes-*/*/*.bb \
	    ${LAYERDIR}/recipes-*/*/*.bbappend"

BBFILE_COLLECTIONS += "iot"
BBFILE_PATTERN_iot = "^${LAYERDIR}/"
BBFILE_PRIORITY_iot = "7"
LAYERVERSION_iot = "1"
```
